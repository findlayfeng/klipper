## src/host/Kconfig
```kconfig
# Kconfig settings for compiling klipper as a host static library
#
# Copyright (C) 2026  Feng Cheng <i@pfeng.top>
#
# This file may be distributed under the terms of the GNU GPLv3 license.
#
# This configuration compiles only the core klipper firmware (scheduler,
# command parsing, console I/O) for the host processor as a static
# library with thread-safe I/O. It does NOT enable any peripherals
# (GPIO/SPI/I2C/ADC/PWM/sensors) - those are not implemented on host.

if MACH_HOST

config BOARD_DIRECTORY
    string
    default "host"

config HOST_SELECT
    bool
    default y

config HOST_LIBRARY_NAME
    string "Static library name"
    default "klipper_host"
    help
        Name of the generated static library (without lib/ .a prefix)

config HOST_FRAME_API
    bool "Hand whole protocol frames to the caller"
    default n
    help
        Adds klipper_host_output_frame(), which returns one complete message
        block per call instead of a byte stream. Klipper already produces
        whole frames, so with this the caller does not have to reassemble
        them, at the cost of a buffer big enough for the largest frame.

        The byte stream API stays available either way.

config HOST_MUX_SERIAL
    bool "Serial mux: address this library's console stream"
    default n
    select MUX_SERIAL
    help
        Makes the library's console stream speak the serial mux: the firmware
        answers a scan with its identity, adopts the node id it is handed, and
        gives its own frames the reply header.

        A mux build is also a bridge build: the routing bridge comes with the
        mux half (src/Kconfig's BRIDGE `default y if`), so this alone is a
        bridge with no ports - its own klipper instance and nothing else.
        HOST_BRIDGE_SERIAL adds the host library's byte-stream backend, so the
        host can hand ports to that bridge at configuration time.

        On by itself for a host library used as one device on a shared stream;
        off by default, the library speaks the plain, headerless wire format.

config HOST_BRIDGE_SERIAL
    bool "Bridge mode: let the host hand this library UART ports"
    default n
    select BRIDGE_PORT_SERIAL
    select MUX_SERIAL
    help
        Klipper has one console, and this library hands it to the caller
        through klipper_host_input()/klipper_host_output(). With this, the arch
        also has a byte stream a host can hand to the bridge as a downstream
        port: a UART object the host creates with config_uart, carrying the tty
        and the rate it names.

        Nothing is opened at init. The library comes up with no ports, and the
        host names them while it configures: a tty that cannot be opened (or a
        rate it cannot set) fails that configuration explicitly. Off by
        default: the library then talks only through the klipper_host_*() API
        and opens no device.

config HOST_BRIDGE_SERIAL_PATH
    string "Serial port the bridge's UART objects open"
    depends on HOST_BRIDGE_SERIAL
    default "/dev/ttyACM0"
    help
        The tty a UART object created with config_uart opens. The host has no
        fixed list of ports to choose from, so this is a path rather than a
        choice; /dev/ttyACM0 is the conventional Linux default (klipper's
        example configs all name it). It is the deployment fact - which tty -
        while the rate is the host's configuration; this backend serves one
        stream, so a second UART object is refused.

config HOST_AR_LIBRARY
    bool "Build as AR static library (.a)"
    default y
    help
        Build the firmware as a static archive (.a) that can be
        linked into other applications.
        
        If disabled, builds a shared library (.so) instead.

config SERIAL
    default y

config CLOCK_FREQ
    int
    default 20000000

endif
```

## src/linux/Kconfig
```kconfig
# Kconfig settings for compiling and running the micro-controller code
# in a Linux process

if MACH_LINUX

config LINUX_SELECT
    bool
    default y
    select HAVE_GPIO
    select HAVE_GPIO_ADC
    select HAVE_GPIO_SPI
    select HAVE_GPIO_I2C
    select HAVE_GPIO_HARD_PWM

config LINUX_CANSERIAL
    bool "CAN bus (on a SocketCAN interface)"
    select CANSERIAL
    help
        Speak can-serial over a CAN interface the kernel already provides
        (linux/can.c), rather than over this process's own console. The
        interface is named on the command line (`-c`, default can0) and has to
        exist; its bit timing is the interface's own, set with `ip link` - a
        vcan interface has none.

        SERIAL stays on beside this: a linux process's console is
        linux/console.c, not the serial backend that symbol selects on other
        arches (generic/serial_irq.c is not built here), so there is no choice
        between the two carriers to make. The pty this target always opens
        stays as well, as the marker its `-I` path points at: with a CAN
        console the protocol runs over the socket, not the pty.

config BOARD_DIRECTORY
    string
    default "linux"

config LINUX_BRIDGE_SERIAL
    bool "Bridge mode: serve one tty as a downstream port"
    default n
    select BRIDGE_PORT_SERIAL
    select MUX_SERIAL
    help
        A linux process's console is one byte stream (linux/console.c), and a
        bridge build hands it more than one port. With this, the process also
        serves a downstream port of its own: a UART object the host creates
        with config_uart opens the tty the launcher named for it in the
        environment (KLIPPER_BRIDGE_PORT_0), at the rate that same command
        carried, and the router (src/bridge.c) writes and reads that port.

        Nothing is opened at init - which tty a port is on is a configuration
        fact - so a port with no tty named, or one that cannot be opened, fails
        that configuration explicitly instead of leaving a bridge that comes up
        without its port. One port is served (slot 0), and a port's RESET_PORT
        has no line to pulse on a tty, so it is dropped in silence.

        This is also a mux build (MUX_SERIAL): the port-level commands and the
        tunnel a flashing host opens travel the console's mux admin channel,
        and the routing bridge comes with the mux half (src/Kconfig's BRIDGE
        `default y if`). On by itself, the process is a mux device with no
        ports - its own klipper instance and nothing else.

config SERIAL
    default y

config CLOCK_FREQ
    int
    default 50000000

endif
```
